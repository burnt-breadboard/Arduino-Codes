#include <Wire.h>
#include <Adafruit_GFX.h>
#include <Adafruit_SSD1306.h>
#include <Fonts/Picopixel.h> 

// --- DISPLAY SETTINGS (2.4" SPI OLED) ---
#define SCREEN_WIDTH 128
#define SCREEN_HEIGHT 64
#define OLED_MOSI  23  // SDA 
#define OLED_CLK   18  // SCK 
#define OLED_DC     2  
#define OLED_CS     5  
#define OLED_RESET  4  

Adafruit_SSD1306 display(SCREEN_WIDTH, SCREEN_HEIGHT, OLED_MOSI, OLED_CLK, OLED_DC, OLED_RESET, OLED_CS);

// --- HARDWARE PINS ---
#define BTN_UP  14
#define BTN_DOWN 12
#define BTN_A  13
#define BUZZER_PIN 25

// --- PITCHES bitches
#define NOTE_G4  392
#define NOTE_A4  440
#define NOTE_B4  494
#define NOTE_C5  523
#define NOTE_D5  587
#define NOTE_E5  659
#define NOTE_F5  698
#define NOTE_G5  784

// --- GAME STATE ---
int enemyHP = 100;
int playerHP = 100;
int menuOption = 0; 
int playerChoice = 0;
int gamePhase = 0; 
bool readyToRestart = false; 
bool melodyPlayed = false; 


// --- SPRITE BEE-BEES (42x42) ---
// Ghost, 42x42px
const unsigned char ghost_glitch[] PROGMEM = { 
  0x00, 0x00, 0x00, 0x00, 0x00, 0x00, 0x00, 0x00, 0x00, 0x00, 0x00, 0x00, 0x00, 0x00, 0x00, 0x00, 
  0x00, 0x00, 0x00, 0x01, 0xff, 0xfc, 0x00, 0x00, 0x00, 0x1d, 0xff, 0xfe, 0x4c, 0x00, 0x00, 0x1f, 
  0x80, 0x2e, 0xec, 0x00, 0x00, 0x4f, 0x80, 0x1f, 0xfc, 0x00, 0x00, 0xee, 0x00, 0x07, 0xfc, 0x00, 
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  0x00, 0x00, 0x00, 0x00, 0x00, 0x00, 0x00, 0x00, 0x00, 0x00, 0x00, 0x00 
  };

  // Fossil Aerodactyl, 42x42px
const unsigned char fossil_aerodactyl [] PROGMEM = {
	0x00, 0x00, 0x00, 0x00, 0x00, 0x00, 0x00, 0x00, 0x00, 0x00, 0x00, 0x00, 0x00, 0x00, 0x00, 0x00, 
	0x00, 0x00, 0x00, 0x00, 0x00, 0x00, 0x00, 0x00, 0x00, 0x00, 0x00, 0x00, 0x00, 0x00, 0x00, 0x00, 
	0x00, 0x00, 0x00, 0x00, 0x00, 0x00, 0x00, 0x00, 0x20, 0x00, 0x02, 0x00, 0x00, 0x00, 0x00, 0x00, 
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	0x00, 0x00, 0x00, 0x00, 0x00, 0x00, 0x00, 0x00, 0x00, 0x00, 0x00, 0x00
};

// Fossil Glitch (MISSINGNO?), 42x42px
const unsigned char fossil_glitch [] PROGMEM = {
	0x00, 0x00, 0x00, 0x00, 0x00, 0x00, 0x00, 0x00, 0x00, 0x00, 0x00, 0x00, 0x00, 0x00, 0x00, 0x00, 
	0x00, 0x00, 0x00, 0x00, 0x00, 0x00, 0x00, 0x00, 0x00, 0x20, 0x00, 0x06, 0x00, 0x00, 0x00, 0x20, 
	0x00, 0x0e, 0x00, 0x00, 0x00, 0x7c, 0xf6, 0x1e, 0x00, 0x00, 0x00, 0x6c, 0xf7, 0x9e, 0x00, 0x00, 
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	0x00, 0x00, 0x00, 0x00, 0x00, 0x00, 0x00, 0x00, 0x00, 0x00, 0x00, 0x00
};

// Gyarados Back, 42x42px sunken
const unsigned char gyarados_back[] PROGMEM = { 
  0x00, 0x00, 0x00, 0x00, 0x00, 0x00, 0x00, 0x00, 0x08, 0x00, 0x00, 0x00, 0x00, 0x00, 0x18, 0x00, 
  0x00, 0x00, 0x00, 0x00, 0x18, 0x00, 0x00, 0x00, 0x00, 0x00, 0x18, 0x00, 0x00, 0x00, 0x00, 0x00, 
  0x18, 0x00, 0x00, 0x00, 0x00, 0x00, 0x18, 0x00, 0x00, 0x00, 0x00, 0x00, 0x18, 0x00, 0x00, 0x00, 
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  0x1f, 0x80, 0x20, 0x00, 0x3e, 0x00, 0x03, 0x88, 0x30, 0x00, 0x1c, 0x00 
  };

// Gyarados Front, 42x42px
const unsigned char gyarados_front [] PROGMEM = {
	0x00, 0x00, 0x00, 0x00, 0x00, 0x00, 0x00, 0x08, 0x06, 0x1e, 0x00, 0x00, 0x00, 0x0c, 0x06, 0x7c, 
	0x00, 0x00, 0x00, 0x08, 0x0f, 0xf8, 0x00, 0x00, 0x00, 0x18, 0x1f, 0xfa, 0x02, 0x00, 0x00, 0x18, 
	0x5e, 0x3e, 0x06, 0x00, 0x01, 0x18, 0x70, 0x18, 0x0c, 0x00, 0x01, 0x3b, 0xc7, 0xc0, 0x78, 0x00, 
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	0x00, 0x00, 0x0f, 0x80, 0x00, 0x80, 0x00, 0x00, 0x00, 0x00, 0x00, 0x00
};

// Charizard Back, 42x42px sunken
const unsigned char charizard_back [] PROGMEM = {
	0x00, 0x00, 0x00, 0x00, 0x00, 0x00, 0x00, 0x00, 0x00, 0x00, 0x00, 0x00, 0x00, 0x00, 0x00, 0x00, 
	0x00, 0x00, 0x00, 0x00, 0x60, 0x00, 0x00, 0x00, 0x00, 0x00, 0xf0, 0x00, 0x00, 0x00, 0x00, 0x00, 
	0x38, 0x00, 0x00, 0x00, 0x00, 0x00, 0x3c, 0x00, 0x00, 0x00, 0x00, 0x00, 0x1e, 0x00, 0x00, 0x00, 
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	0x66, 0x7e, 0x64, 0xdf, 0x70, 0x00, 0x00, 0x00, 0x00, 0x00, 0x00, 0x00
};

// Charizard Front, 42x42px
const unsigned char charizard_front [] PROGMEM = {
	0x00, 0x00, 0x00, 0x00, 0x00, 0x00, 0x00, 0x03, 0x00, 0x00, 0x00, 0x00, 0x00, 0xe7, 0x90, 0x04, 
	0x00, 0x00, 0x01, 0xbc, 0x5c, 0x04, 0x00, 0x00, 0x01, 0x7c, 0x19, 0x46, 0x00, 0x00, 0x00, 0x3f, 
	0xfc, 0x63, 0x80, 0x00, 0x00, 0x0f, 0xfc, 0x01, 0xc0, 0x00, 0x00, 0x00, 0xb8, 0x01, 0x20, 0x00, 
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	0x0d, 0x83, 0x33, 0x80, 0x00, 0x00, 0x00, 0x00, 0x80, 0x00, 0x00, 0x00
};

// Alakazam Back, 42x42px sunken
const unsigned char alakazam_back [] PROGMEM = {
	0x18, 0x00, 0x00, 0x00, 0x30, 0x00, 0x38, 0x00, 0x00, 0x00, 0x30, 0x00, 0x78, 0x00, 0x00, 0x00, 
	0x30, 0x00, 0x1c, 0x80, 0x00, 0x00, 0x70, 0x00, 0x1f, 0x80, 0x00, 0x00, 0xe0, 0x00, 0x0f, 0x80, 
	0x00, 0x01, 0xc0, 0x00, 0x03, 0xf0, 0x00, 0x03, 0xc0, 0x00, 0x03, 0xf0, 0x00, 0x07, 0x80, 0x00, 
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	0x00, 0x00, 0x00, 0x00, 0x00, 0x00, 0x00, 0x00, 0x00, 0x00, 0x00, 0x00
};

// Alakazam Front, 42x42px
const unsigned char alakazam_front [] PROGMEM = {
	0x00, 0x00, 0x00, 0x00, 0x00, 0x00, 0x00, 0x70, 0x00, 0x01, 0x80, 0x00, 0x00, 0x38, 0x00, 0x03, 
	0x80, 0x00, 0x00, 0x1c, 0x00, 0x06, 0x00, 0x00, 0x00, 0x0e, 0x00, 0x0e, 0x00, 0x00, 0x00, 0x07, 
	0x00, 0x1c, 0x00, 0x00, 0x00, 0x07, 0x80, 0x1c, 0x00, 0x00, 0x00, 0x03, 0xc0, 0x38, 0x00, 0x00, 
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	0x00, 0x80, 0x80, 0x00, 0x00, 0x00, 0x00, 0x00, 0x00, 0x00, 0x00, 0x00
};

// Psyduck front 42x42px
const unsigned char psyduck_front [] PROGMEM = {
	0x00, 0x00, 0x00, 0x00, 0x00, 0x00, 0x00, 0x00, 0x00, 0x00, 0x00, 0x00, 0x00, 0x00, 0x00, 0x00, 
	0x00, 0x00, 0x00, 0x00, 0x00, 0x00, 0x00, 0x00, 0x00, 0x00, 0x00, 0x00, 0x00, 0x00, 0x00, 0x00, 
	0x00, 0x00, 0x00, 0x00, 0x00, 0x00, 0x00, 0x00, 0x00, 0x00, 0x00, 0x00, 0x00, 0x00, 0x00, 0x00, 
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	0x00, 0x00, 0x1f, 0xff, 0xff, 0xc0, 0x00, 0x00, 0x0f, 0xff, 0xff, 0xc0
};

//Psyduck Back, 42x42px sunken
const unsigned char psyduck_back [] PROGMEM = {
	0x00, 0x02, 0x01, 0x80, 0x00, 0x00, 0x00, 0x03, 0x01, 0x80, 0x00, 0x00, 0x00, 0x03, 0xff, 0x00, 
	0x00, 0x00, 0x00, 0x1f, 0xff, 0x80, 0x00, 0x00, 0x00, 0x3f, 0x3f, 0xf0, 0x00, 0x00, 0x00, 0x0f, 
	0x3f, 0xf0, 0x00, 0x00, 0x00, 0x4f, 0x3f, 0xf8, 0x00, 0x00, 0x01, 0xf3, 0x3f, 0xfc, 0x00, 0x00, 
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	0x00, 0x00, 0x00, 0x00, 0x00, 0x00, 0x00, 0x00, 0x00, 0x00, 0x00, 0x00
};

const unsigned char* playerBackSprites[] = { gyarados_back, charizard_back, alakazam_back, psyduck_back };
const unsigned char* playerFrontSprites[] = { gyarados_front, charizard_front, alakazam_front, psyduck_front };
const char* playerNames[] = { "GYARADOS", "CHARIZARD", "ALAKAZAM", "PSYDUCK" };

const char* moveNames[4][3] = {
  {"HYDRO PUMP", "DRAGON RAGE", "BITE"},    // Gyarados
  {"FLAMETHROWER", "FIRE BLAST", "SLASH"},  // Charizard
  {"PSYBEAM", "RECOVER", "CONFUSION"},  // Alakazam 
  {"HEADACHE", "TRIGGER FINGER", "WEIRD LEG"},   // Psyduck 
};

// --- ENEMY DATA ---
const unsigned char* enemySprites[] = { ghost_glitch, fossil_aerodactyl, fossil_glitch }; 
const char* enemyNames[] = { "GHOST", "FOSSIL AERODACTYL", "MISSINGNO" };
int currentEnemy = 0; // Stores which one was picked

const char* enemyMoves[3][3] = {
  {"LICK", "NIGHT SHADE", "DREAM EATER"}, // Ghost
  {"HYPER BEAM", "MEGA PUNCH", "SWIFT"},    // Fossil Aerodactyl 
  {"SLASH", "SWORDS DANCE", "ICE BEAM"}    // MISSINGNO 
};


// --- PROTOTYPES ---
void typebox(const __FlashStringHelper* text, int speed);
void typebox(String text, int speed);
void drawStaticUI();
void startBattle();
void executeMove();
void showOutro();
void drawMenu();
void handleMenuInput();
void softShake(int intensity, int duration);
void playerShake(int intensity, int duration);
void drainEnemyHP(int damage);
void drainPlayerHP(int damage);
void healPlayer(int amount);

// --- SETUP ---
void setup() {
  // Wire.begin(PIN_SDA, PIN_SCL);   <----for I2C screen
  // Wire.setClock(400000);
   if(!display.begin(SSD1306_SWITCHCAPVCC)) for(;;); 
  
  pinMode(BTN_A, INPUT_PULLUP);
  pinMode(BTN_UP, INPUT_PULLUP);
  pinMode(BTN_DOWN, INPUT_PULLUP);
  pinMode(BUZZER_PIN, OUTPUT);
  randomSeed(analogRead(0));

  display.clearDisplay();
  display.setTextColor(SSD1306_WHITE); 

  // --- INTRO SCREEN DRAWING ---
  display.setFont(); 
  display.setTextSize(2);
  display.setCursor(28, 10);
  display.print(F("ROBERT"));

  display.setTextSize(1);
  display.setCursor(15, 30);
  display.print(F("grew to level 37!"));
  display.display();

  // --- Global Font Change ---
  display.setFont(&Picopixel); 
  display.setTextSize(1);
  display.setTextColor(SSD1306_WHITE); // Set it again here just to be safe
  display.setCursor(10, 55);
  display.print(F("Press  A  for  a  birthday  battle!"));

  display.display();
}

// --- MAIN LOOP ---
void loop() {
  switch (gamePhase) {
    case 0: // Phase 0: INTRO
      if (digitalRead(BTN_A) == LOW) {
        while(digitalRead(BTN_A) == LOW); delay(250);
        gamePhase = 1;
      }
      break;

    case 1: // Phase 1: SELECTION
      drawSelectionMenu(); 
      break;

    case 2: // Phase 2: BATTLE
      if (gamePhase == 2) { 
        handleMenuInput();
        drawMenu();
      }
      break;

    case 3: // Phase 3: OUTRO
   showOutro();
   if (digitalRead(BTN_A) == LOW) {
    while(digitalRead(BTN_A) == LOW);
    delay(200);
    enemyHP = 100;
    playerHP = 100;
    melodyPlayed = false; // <--- RESETS THE FLAG 
    gamePhase = 0;
    display.clearDisplay();
    display.display();
    setup();  // Girl, IDK. It keeps the font from resetting
  }
  break;

    case 4: // Phase 4: DEFEAT
      display.clearDisplay(); 
      display.setTextSize(2);
      display.setCursor(40, 20);
      display.print(F("ROBERT"));
      display.setCursor(25, 35);
      display.print(F("BLACKED OUT!"));
      
      display.setTextSize(1);
      display.setCursor(18, 50);
      display.print(F("DOUBLE-CLICK  A  TO RESTART"));
      display.display();

      //You know what, just double click then. It's a feature not a bug, bitch. 
      if (digitalRead(BTN_A) == HIGH) {
        readyToRestart = true; 
      }

      if (readyToRestart == true && digitalRead(BTN_A) == LOW) {
        delay(100); // Debounce
        while(digitalRead(BTN_A) == LOW); // Wait for final release
        
        // RESET EVERYTHING
        playerHP = 100;
        enemyHP = 100;
        readyToRestart = false; 
        gamePhase = 0;  
      }
      break;
   }
  }

// --- FUNCTIONS ---
void drawSelectionMenu() {
  display.clearDisplay();
  display.setCursor(5, 10);
  display.print(F("SELECT YOUR POKEMON:"));
  for(int i = 0; i < 4; i++) {
    display.setCursor(10, 25 + (i * 10));
    display.print(playerChoice == i ? F(">") : F(" "));
    display.print(playerNames[i]);
  }
  display.drawBitmap(80, 15, playerFrontSprites[playerChoice], 42, 42, WHITE);
  display.display();

  if (digitalRead(BTN_UP) == LOW) {
    playerChoice = (playerChoice - 1 + 4) % 4;
    tone(BUZZER_PIN, 400, 50);
    while(digitalRead(BTN_UP) == LOW); delay(200);
  }
  if (digitalRead(BTN_DOWN) == LOW) {
    playerChoice = (playerChoice + 1) % 4;
    tone(BUZZER_PIN, 400, 50);
    while(digitalRead(BTN_DOWN) == LOW); delay(200);
  }
  if (digitalRead(BTN_A) == LOW) {
    while(digitalRead(BTN_A) == LOW); delay(250);
    randomSeed(millis());
    currentEnemy = random(0, 3);
    gamePhase = 2;
    startBattle();
  }
}

void executeMove() {
  String currentMove = moveNames[playerChoice][menuOption];
  typebox(String(playerNames[playerChoice]) + " used", 40);
  typebox(currentMove + "!", 40);

  // --- ALAKAZAM RECOVER LOGIC ---
  if (playerChoice == 2 && menuOption == 1) { 
    int healAmount = 35; // Amount to heal
    typebox(F("HP was restored!"), 50);
    healPlayer(healAmount);
  } 
  // --- STANDARD ATTACK LOGIC ---
  else {
    if (random(0, 100) < 15) {
      typebox(String(playerNames[playerChoice]) + "'s attack missed", 40);
    } else {
      bool isCrit = (random(0, 100) > 85);
      int damage = random(25, 45) * (isCrit ? 1.5 : 1);
      tone(BUZZER_PIN, 150, 200);
      delay(200);
      softShake(isCrit ? 6 : 3, 10);
      if (isCrit) typebox(F("CRITICAL HIT!"), 30);
      drainEnemyHP(damage);
    }
  }

  // Check for Victory
 if (enemyHP <= 0) { 
    typebox(String("Enemy ") + enemyNames[currentEnemy] + " fainted!", 40);
    delay(1000); 
    gamePhase = 3; 
    return; 
}

   // --- ENEMY TURN ---
  delay(1000);
  // Pick a random move index (0, 1, or 2)
  int randomMove = random(0, 3);
  typebox(String(enemyNames[currentEnemy]) + " used", 40); 
  // Display the randomly chosen move name
  typebox(String(enemyMoves[currentEnemy][randomMove]) + "!", 40); 
  playerShake(3, 10);
  
  int enemyDamage = random(15, 30);
  if (randomMove == 2) enemyDamage += 20; // Make the 3rd move a "Heavy" attack
  
  drainPlayerHP(enemyDamage);

  // 3. NEW: Check for Defeat
  if (playerHP <= 0) { 
    typebox(String(playerNames[playerChoice]) + " fainted!", 40);
    delay(1000);
    typebox(F("Robert is out of usable Pokemon..."), 40);
    
    // Reset everything to "Fresh Start" state
    playerHP = 100;
    enemyHP = 100;
    melodyPlayed = false;

    gamePhase = 4; 
    
    // Clear the screen
    display.clearDisplay();
    display.display();
    
    // 4. IMPORTANT: Exit this function NOW so it doesn't draw the menu again
    return;
  }
}

void drawStaticUI() {
  display.drawRect(0, 44, 128, 20, WHITE);
  display.setCursor(2, 6); display.print(enemyNames[currentEnemy]);
  display.drawRect(2, 9, 34, 5, WHITE);
  display.fillRect(4, 11, map(enemyHP, 0, 100, 0, 30), 1, WHITE);
  display.setCursor(80, 50); display.print(playerNames[playerChoice]);
  display.drawRect(80, 53, 34, 5, WHITE); 
  display.fillRect(82, 55, map(playerHP, 0, 100, 0, 30), 1, WHITE);
}

void startBattle() {
  display.clearDisplay();
  display.drawBitmap(84, 2, enemySprites[currentEnemy], 42, 42, WHITE); 
  display.drawBitmap(2, 12, playerBackSprites[playerChoice], 42, 42, WHITE); 
  drawStaticUI();
  display.display();
  typebox(String(playerNames[playerChoice]) + ", I choose you!", 40);
}

void drawMenu() {
  display.fillRect(1, 45, 126, 18, BLACK);
  display.setCursor(6, 56); display.print(F("MOVE:"));

  display.setCursor(65, 50); 
  display.print(menuOption == 0 ? F(">") : F(" ")); 
  display.print(moveNames[playerChoice][0]);

  display.setCursor(65, 56); 
  display.print(menuOption == 1 ? F(">") : F(" ")); 
  display.print(moveNames[playerChoice][1]);

  display.setCursor(65, 62); 
  display.print(menuOption == 2 ? F(">") : F(" ")); 
  display.print(moveNames[playerChoice][2]);

  display.display();
}

void handleMenuInput() {
  if (digitalRead(BTN_UP) == LOW) {
    menuOption = (menuOption - 1 + 3) % 3;
    tone(BUZZER_PIN, 400, 50);
    while(digitalRead(BTN_UP) == LOW); delay(100);
  }
  if (digitalRead(BTN_DOWN) == LOW) {
    menuOption = (menuOption + 1) % 3;
    tone(BUZZER_PIN, 400, 50);
    while(digitalRead(BTN_DOWN) == LOW); delay(100);
  }
  if (digitalRead(BTN_A) == LOW) {
    while(digitalRead(BTN_A) == LOW); executeMove();
  }
}

void showOutro() {
  display.clearDisplay();
  
  // 1. VICTORY! (System font size 2)
  display.setFont(); 
  display.setTextSize(2);
  display.setCursor(16, 5); 
  display.print(F("VICTORY!"));

  // 2. HAPPY BIRTHDAY (Picopixel font)
  display.setFont(&Picopixel);
  display.setTextSize(2); 
  display.setCursor(9, 40); 
  display.print(F("HAPPY BIRTHDAY!"));

  // 3. PRESS A TO REPLAY (System font size 1)
  display.setFont(); 
  display.setTextSize(1);
  display.setCursor(13, 56);
  display.print(F("PRESS A TO REPLAY"));

  display.display();

   if (!melodyPlayed) {
    playVictoryMelody();
    melodyPlayed = true; 
  }
}


void drainEnemyHP(int damage) {
  int targetHP = enemyHP - damage;
  if (targetHP < 0) targetHP = 0;
  for (int i = enemyHP; i >= targetHP; i--) {
    enemyHP = i;
    display.fillRect(4, 11, 31, 1, BLACK); 
    display.fillRect(4, 11, map(enemyHP, 0, 100, 0, 30), 1, WHITE);
    tone(BUZZER_PIN, map(enemyHP, 100, 0, 800, 200), 20);
    display.display();
    delay(40);
  }
  noTone(BUZZER_PIN);
}

void drainPlayerHP(int damage) {
  int targetHP = playerHP - damage;
  if (targetHP < 0) targetHP = 0;
  for (int i = playerHP; i >= targetHP; i--) {
    playerHP = i;
    display.fillRect(82, 55, 31, 1, BLACK); 
    display.fillRect(82, 55, map(playerHP, 0, 100, 0, 30), 1, WHITE);
    tone(BUZZER_PIN, 1200 - (playerHP * 5), 20); 
    display.display();
    delay(40);
  }
  noTone(BUZZER_PIN);
}

void softShake(int intensity, int duration) {
  for (int i = 0; i < duration; i++) {
    int x = random(-intensity, intensity + 1);
    display.clearDisplay();
    display.drawBitmap(84 + x, 2, enemySprites[currentEnemy], 42, 42, WHITE);
    display.drawBitmap(2, 12, playerBackSprites[playerChoice], 42, 42, WHITE);
    drawStaticUI();
    display.display();
    delay(30);
  }
}

void playerShake(int intensity, int duration) {
  for (int i = 0; i < duration; i++) {
    int x = random(-intensity, intensity + 1);
    display.clearDisplay();
    display.drawBitmap(84, 2, enemySprites[currentEnemy], 42, 42, WHITE);
    display.drawBitmap(2 + x, 12, playerBackSprites[playerChoice], 42, 42, WHITE);
    drawStaticUI();
    display.display();
    delay(30);
  }
}

void typebox(const __FlashStringHelper* text, int speed) {
  display.fillRect(1, 45, 126, 18, BLACK);
  display.setCursor(6, 56);
  String s = String(text);
  for (int i = 0; i < s.length(); i++) {
    display.print(s[i]); display.display(); 
    if (digitalRead(BTN_A) == LOW) speed = 5;
    delay(speed);
  }
  delay(500);
}

void typebox(String text, int speed) {
  display.fillRect(1, 45, 126, 18, BLACK);
  display.setCursor(6, 56);
  for (int i = 0; i < text.length(); i++) {
    display.print(text[i]); display.display(); 
    if (digitalRead(BTN_A) == LOW) speed = 5;
    delay(speed);
  }
  delay(500);
}

  void healPlayer(int amount) {
  int targetHP = playerHP + amount;
  if (targetHP > 100) targetHP = 100;

  for (int i = playerHP; i <= targetHP; i++) {
    playerHP = i;
    display.fillRect(82, 53, 31, 1, BLACK); // Clears the old bar
    display.fillRect(82, 53, map(playerHP, 0, 100, 0, 30), 1, WHITE);
    tone(BUZZER_PIN, 400 + (playerHP * 4), 20); 
    display.display();
    delay(40);
  }
  noTone(BUZZER_PIN);
}

  void playVictoryMelody() {
  int melody[] = { NOTE_G4, NOTE_B4, NOTE_D5, NOTE_G5 };
  int durations[] = { 100, 100, 100, 300 }; 

  for (int i = 0; i < 4; i++) {
    tone(BUZZER_PIN, melody[i], durations[i]);
    delay(durations[i] * 1.2); // Small gap between notes for clarity
  }
  noTone(BUZZER_PIN);
}
